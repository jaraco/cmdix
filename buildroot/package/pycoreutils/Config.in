## buildroot/package/pycoreutils/Config.in
```kconfig
config BR2_PACKAGE_PYCOREUTILS
	bool "pycoreutils"
	depends on BR2_PACKAGE_PYTHON
	help
	  coreutils in pure python
```

## buildroot/package/virtualenv/Config.in
```kconfig
config BR2_PACKAGE_VIRTUALENV
	bool "virtualenv"
	depends on BR2_PACKAGE_PYTHON
	help
	  virtualenv
```
